/* source key position labels */
#include "zmk-helpers/key-labels/42.h"

/* map Corne's extra keys */
#define X_LT &trans
#define X_LM &none
#define X_LB &none
#define X_LH &none

#define X_RT &trans
#define X_RM &none
#define X_RB &none
#define X_RH &none

/* activate bluetooth */
#define CONFIG_WIRELESS 1

/* source the main keymap */
#include "base.keymap"
